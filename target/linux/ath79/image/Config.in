## target/linux/ath79/image/Config.in
```kconfig
config BUILD_BOOTLOADER
	bool
	depends on BUILD_FACTORY_IMAGE && TARGET_ath79
	select PACKAGE_uboot-ath79

config RUT9_MIGRATION
	bool "RUT9 Migration scripts and their dependencies"
	depends on TARGET_ath79_74kc_DEVICE_teltonika_rut9xx
	default y
	select BUSYBOX_CONFIG_BASE64

config RUT2_MIGRATION
	bool "RUT2 Migration scripts and their dependencies"
	depends on TARGET_ath79_24kc_DEVICE_teltonika_rut2xx
	default y
	select BUSYBOX_CONFIG_BASE64
```
